/*******************************************************************************
*                 
*                 		       普中科技
--------------------------------------------------------------------------------
* 实 验 名		 : PWM实验
* 实验说明       : 通过定时器3输出一个PWM控制LED小灯，LED小灯呈现呼吸效果
* 连接方式       : 
* 注    意		 : 	所用函数在头文件.c文件内
*******************************************************************************/


#include "public.h"
#include "pwm.h"
#include "systick.h"

/****************************************************************************
* Function Name  : main
* Description    : Main program.
* Input          : None
* Output         : None
* Return         : None
****************************************************************************/
int main()
{	
	u8 fx=1;//方向
	u32 ti=0;	  	  
	pwm_init();	 //PWM初始化
	while(1)
	{
		delay_ms(10);
		if(fx==1)		
		{
			ti++;
			if(ti>300)		
			{
				fx=0;
			}
		}
		else
		{
			ti--;
			if(ti==0)
			{
				fx=1;
			}
		}
		TIM_SetCompare2(TIM3, ti);//设置TIMx捕获比较2寄存器值		
	}
}



